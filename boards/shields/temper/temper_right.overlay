/*
 * Temper Right – test 1 columna
 */

#include "temper.dtsi"

&default_transform {
    columns = <1>;
    rows = <4>;
    map = <
        RC(0,0)
        RC(1,0)
        RC(2,0)
        RC(3,0)
    >;
};

&kscan0 {
    col-gpios
        = <&pro_micro 15 GPIO_ACTIVE_HIGH>
        ;
};
